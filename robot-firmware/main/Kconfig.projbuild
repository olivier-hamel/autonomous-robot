## robot-firmware/main/Kconfig.projbuild
```kconfig
menu "Project Configuration"

    orsource "$IDF_PATH/examples/common_components/env_caps/$IDF_TARGET/Kconfig.env_caps"

    config I2C_MASTER_SCL
        int "SCL GPIO Num"
        range ENV_GPIO_RANGE_MIN ENV_GPIO_OUT_RANGE_MAX
        default 6
        help
            GPIO number for I2C Master clock line.

    config I2C_MASTER_SDA
        int "SDA GPIO Num"
        range ENV_GPIO_RANGE_MIN ENV_GPIO_OUT_RANGE_MAX
        default 7
        help
            GPIO number for I2C Master data line.

    config I2C_MASTER_FREQUENCY
        int "Master Frequency"
        default 400000
        help
            I2C Speed of Master device.

    menu "micro-ROS"

        config ROBOT_MICRO_ROS_INT32_PUBLISHER
            bool "Enable micro-ROS Int32 publisher"
            default y
            depends on MICRO_ROS_ESP_XRCE_DDS_MIDDLEWARE
            depends on MICRO_ROS_ESP_UART_TRANSPORT
            help
                Starts a micro-ROS node in its own FreeRTOS task using the custom UART transport.

        config ROBOT_MICRO_ROS_APP_STACK
            int "Stack for micro-ROS task (bytes)"
            default 16000
            depends on ROBOT_MICRO_ROS_INT32_PUBLISHER

        config ROBOT_MICRO_ROS_APP_TASK_PRIO
            int "Priority for micro-ROS task"
            default 5
            depends on ROBOT_MICRO_ROS_INT32_PUBLISHER

        config ROBOT_MICRO_ROS_UART_PORT
            int "UART port for micro-ROS (0=UART0, 1=UART1)"
            range 0 1
            default 1
            depends on ROBOT_MICRO_ROS_INT32_PUBLISHER
            help
                UART number used by micro-ROS serial transport. UART1 is recommended to avoid conflicts
                with the default console on UART0.

        config ROBOT_MICRO_ROS_UART_BAUDRATE
            int "UART baudrate for micro-ROS"
            default 115200
            depends on ROBOT_MICRO_ROS_INT32_PUBLISHER

    endmenu

endmenu
```
